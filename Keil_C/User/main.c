/**
 *****************************************************************************************************
  * @copyright	(c)  Shenzhen Saiyuan Microelectronics Co., Ltd
  * @file	         main.c
  * @author	 
  * @version 	
  * @date	
  * @brief	         
  * @details         Contains the MCU initialization function and its H file
 *****************************************************************************************************
 * @attention
 *
 *****************************************************************************************************
 */
/*******************Includes************************************************************************/

#include "SC_Init.h"
#include "SC_it.h"
#include "..\Drivers\SCDriver_list.h"
#include "HeadFiles\SysFunVarDefine.h"
#include "FreeRTOS.h"
#include "task.h"
#include "DMA-Buffer-Manager.h"

/**************************************Generated by EasyCodeCube*************************************/
//Forbid editing areas between the labels !!!

/*************************************.Generated by EasyCodeCube.************************************/

static TaskHandle_t tasks;
DMA_Buffer_Manager Manager;

void vTask_Monitor(void *pvParameters)
{
	for (;;)
	{
		GPIO_TogglePins(GPIOB, GPIO_Pin_15);
		DMA_Buffer_Manager_Input(&Manager, (uint8_t *)"0123456789", 10);
		//DMA_Buffer_Manager_Input(&Manager, (uint8_t *)"0123456789", 10);
		//DMA_Buffer_Manager_Input(&Manager, (uint8_t *)"0123456789", 10);
		//DMA_Buffer_Manager_Input(&Manager, (uint8_t *)"0123456789", 10);
		//DMA_Buffer_Manager_Input(&Manager, (uint8_t *)"0123456789", 10);
	    vTaskDelay(500);
	}
}

void vTask_Monitor1(void *pvParameters)
{
	for (;;)
	{
		DMA_Buffer_Manager_Input(&Manager, (uint8_t *)"Hello xxxxx! Task 1\n", 20);
        GPIO_TogglePins(GPIOB, GPIO_Pin_15);
	    vTaskDelay(300);
	}
}

/**
  * @brief This function implements main function.
  * @note 
  * @param
  */
int main(void)
{	
    IcResourceInit();
	DMA_Buffer_Manager_Initialize(&Manager, 64, DMA0, UART0, DMA_UART);

    xTaskCreate(vTask_Monitor, "Monitor", 128, NULL, 1, &tasks);
    //xTaskCreate(vTask_Monitor1, "Monitor", 72, NULL, 1, &tasks);
    vTaskStartScheduler();
    
    while (1) {}
}
